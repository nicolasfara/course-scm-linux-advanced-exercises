## yocto/02-custom-distro/build/conf/bblayers.conf
```bitbake
# Configuration file for adding layers

# LAYER_CONF_VERSION is increased each time build/conf/bblayers.conf
# changes incompatibly
LCONF_VERSION = "7"

BBLAYERS ?= " \
    ${TOPDIR}/../openembedded-core/meta \
    ${TOPDIR}/../meta-raspberrypi \
    ${TOPDIR}/../meta-openembedded/meta-oe \
    ${TOPDIR}/../meta-openembedded/meta-python \
"
```

## yocto/02-custom-distro/build/conf/local.conf
```bitbake
# Machine configuration
MACHINE ?= "raspberrypi4-64"

# Default distro (define your own, if desired)
DISTRO ?= "nodistro"

# Package management
PACKAGE_CLASSES ?= "package_rpm"

# Enable extra debugging tools
EXTRA_IMAGE_FEATURES ?= "debug-tweaks"

# Image types to generate
IMAGE_FSTYPES = "rpi-sdimg"

INHERIT += " rm_work"

LICENSE_FLAGS_ACCEPTED = "commercial license synaptics-killswitch"
```

## yocto/02-custom-distro/meta-scmdistro/conf/distro/scmdistro.conf
```bitbake
include conf/distro/defaultsetup.conf

DISTRO = "scmdistro"
DISTRO_NAME = "SCM Distro reference"
DISTRO_VERSION = "1.0"
DISTRO_CODENAME = "Orion"
TCLIBC = "glibc"

MAINTAINER = "nicolas.farabegoli@unibo.it"

INHIBIT_PACKAGE_DEBUG_SPLIT = "1"

DISTRO_FEATURES:append = " systemd"
DISTRO_FEATURES_BACKFILL_CONSIDERED += "sysvinit"
VIRTUAL-RUNTIME:init_manager = "systemd"
VIRTUAL-RUNTIME:initscripts = "systemd-compat-units"
```

## yocto/02-custom-distro/meta-scmdistro/conf/layer.conf
```bitbake
# We have a conf and classes directory, add to BBPATH
BBPATH .= ":${LAYERDIR}"

# We have recipes-* directories, add to BBFILES
BBFILES += "${LAYERDIR}/recipes-*/*/*.bb \
            ${LAYERDIR}/recipes-*/*/*.bbappend"

BBFILE_COLLECTIONS += "meta-scmdistro"
BBFILE_PATTERN_meta-scmdistro = "^${LAYERDIR}/"
BBFILE_PRIORITY_meta-scmdistro = "6"

LAYERDEPENDS_meta-scmdistro = "core"
LAYERSERIES_COMPAT_meta-scmdistro = "scarthgap"
```
